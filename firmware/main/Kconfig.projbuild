## firmware/main/Kconfig.projbuild
```kconfig
menu "YT Music board"

config YTM_USE_NET
    bool "Use the live network feed (bridge) instead of mock data"
    default y
    help
        When set, the board connects to the Mac-side ytmdesktop bridge over
        WebSocket (discovered via mDNS) and fills the view-model from it.
        When unset, the firmware drives the screen from mock.c — useful for an
        offline demo on hardware. The desktop simulator always uses mock.

choice YTM_THEME
    prompt "UI theme"
    default YTM_THEME_DARK
    help
        Build-time theme for the Now Playing screen. Dark is the V2 default
        (near-black, AMOLED-friendly, with the album-derived ambient glow).
        Light is the same layout painted with light tokens and the glow
        disabled. There is no runtime toggle; the V1 cream design is gone.

    config YTM_THEME_DARK
        bool "Dark (default)"

    config YTM_THEME_LIGHT
        bool "Light"
endchoice

config YTM_DISPLAY_BRIGHTNESS
    int "Display brightness (percent)"
    range 5 100
    default 40
    help
        AMOLED panel brightness, 5-100%. The screen comes up at this level on
        boot; lower it if the display is too bright (full brightness is harsh).
        Applied via the BSP after panel init — AMOLED dims with a panel command,
        there is no separate backlight to PWM.

config YTM_IDLE_DIM_ENABLE
    bool "Auto-dim the screen after idle"
    default y
    help
        When set, the screen dims to YTM_IDLE_DIM_PERCENT after
        YTM_IDLE_DIM_MS of no touch and no physical movement, but only while
        nothing is playing. Any touch or motion (QMI8658 IMU) restores the
        user's brightness. When unset, the screen never auto-dims and behaves
        exactly as before.

config YTM_IDLE_DIM_MS
    int "Idle time before dimming (ms)"
    depends on YTM_IDLE_DIM_ENABLE
    default 30000
    range 1000 600000
    help
        Milliseconds with no touch and no motion (and nothing playing) before
        the screen dims.

config YTM_IDLE_DIM_PERCENT
    int "Dimmed brightness (percent)"
    depends on YTM_IDLE_DIM_ENABLE
    default 10
    range 1 100
    help
        Panel brightness while dimmed. Restored to the user's level on any
        interaction.

config YTM_IDLE_POWEROFF_ENABLE
    bool "Power off the board after a longer idle"
    depends on YTM_IDLE_DIM_ENABLE
    default y
    help
        When set, the board performs an AXP2101 soft power-off after it has been
        idle (nothing playing, no touch, no motion) for longer than the dim
        timeout. Waking requires a physical PWRON button press. The timeout is
        shorter on battery than on external (cable) power. When unset, the board
        only dims and never powers itself off.

config YTM_IDLE_OFF_BATTERY_MS
    int "Idle time before power-off on battery (ms)"
    depends on YTM_IDLE_POWEROFF_ENABLE
    default 300000
    range 60000 3600000
    help
        Milliseconds idle (nothing playing, no touch, no motion) before the board
        powers off while running on battery. Must exceed YTM_IDLE_DIM_MS. (Not
        enforced by the range — set it higher than the dim timeout.)

config YTM_IDLE_OFF_CABLE_MS
    int "Idle time before power-off on cable (ms)"
    depends on YTM_IDLE_POWEROFF_ENABLE
    default 900000
    range 60000 3600000
    help
        Milliseconds idle before the board powers off while on external (cable)
        power. Typically longer than the battery timeout. Must exceed
        YTM_IDLE_DIM_MS. (Not enforced by the range — set it higher than the
        dim timeout.)

config YTM_WIFI_SSID
    string "WiFi SSID"
    default "changeme"
    depends on YTM_USE_NET
    help
        SSID of the network the bridge (Mac) is on.

config YTM_WIFI_PASSWORD
    string "WiFi password"
    default "changeme"
    depends on YTM_USE_NET
    help
        WPA2 passphrase. Leave empty for an open network.

config YTM_BRIDGE_HOST
    string "Bridge host fallback (optional)"
    default ""
    depends on YTM_USE_NET
    help
        If set, skip mDNS and connect straight to this host (e.g. "192.168.1.50").
        Leave empty to discover the bridge via _ytmboard._tcp.

config YTM_BRIDGE_PORT
    int "Bridge port fallback"
    default 8765
    depends on YTM_USE_NET
    help
        Port used with the host fallback above, and as a default if the mDNS TXT
        record omits one.

endmenu
```

## firmware/sdkconfig.defaults
```kconfig
# --- ESP32-S3R8: 8MB octal PSRAM, 16MB flash (SPEC §2) ---
CONFIG_IDF_TARGET="esp32s3"
CONFIG_SPIRAM=y
CONFIG_SPIRAM_MODE_OCT=y
CONFIG_SPIRAM_SPEED_80M=y
CONFIG_ESPTOOLPY_FLASHSIZE_16MB=y
CONFIG_ESPTOOLPY_FLASHMODE_QIO=y

# big-APP partition scheme (Wi-Fi/TLS/LVGL all resident later)
CONFIG_PARTITION_TABLE_CUSTOM=y
CONFIG_PARTITION_TABLE_CUSTOM_FILENAME="partitions.csv"

# smoother LVGL animation
CONFIG_FREERTOS_HZ=1000

# --- LVGL v9 (managed lvgl component Kconfig) ---
CONFIG_LV_COLOR_DEPTH_16=y
# Inter, not Montserrat: the UI renders in bundled Inter (ui/inter_*.c, generated
# by scripts/gen_fonts.sh) and sets per-role fonts explicitly. We drop the four
# larger Montserrat placeholders this slice no longer uses and move LVGL's
# internal default font to the tiny built-in unscii_8 — it is never rendered by
# the screen. (Montserrat 14 stays auto-enabled by LVGL's Kconfig because its
# bundled examples reference it; our UI does not.)
CONFIG_LV_FONT_UNSCII_8=y
CONFIG_LV_FONT_DEFAULT_UNSCII_8=y
```
